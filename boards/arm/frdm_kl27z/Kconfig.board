## boards/arm/frdm_kl27z/Kconfig.board
```kconfig
# Kconfig - FRDM-KL27Z board
#
# Copyright (c) 2017, NXP
#
# SPDX-License-Identifier: Apache-2.0
#

config BOARD_FRDM_KL27Z
	bool "NXP FRDM-KL27Z"
	depends on SOC_SERIES_KINETIS_KL2X
	select SOC_PART_NUMBER_MKL27Z64VLH4
```

## boards/arm/frdm_kl27z/Kconfig.defconfig
```kconfig
# Kconfig - FRDM-KL27Z board
#
# Copyright (c) 2017, NXP
#
# SPDX-License-Identifier: Apache-2.0
#

if BOARD_FRDM_KL27Z

config BOARD
	default "frdm_kl27z"

config OSC_XTAL0_FREQ
	default 8000000

config MCG_PRDIV0
	default 0x01

config MCG_VDIV0
	default 0x00

config MCG_FRDIV
	default 5

config MCG_FCRDIV
	default 0

if PINMUX_MCUX

config PINMUX_MCUX_PORTA
	default y

config PINMUX_MCUX_PORTB
	default y

config PINMUX_MCUX_PORTC
	default y

config PINMUX_MCUX_PORTD
	default y if I2C_1

config PINMUX_MCUX_PORTE
	default y if I2C_0

endif # PINMUX_MCUX

if GPIO_MCUX

config GPIO_MCUX_PORTA
	default y

config GPIO_MCUX_PORTB
	default y

config GPIO_MCUX_PORTC
	default y

config GPIO_MCUX_PORTD
	default y

config GPIO_MCUX_PORTE
	default y

endif # GPIO_MCUX

if UART_MCUX_LPUART

config UART_MCUX_LPUART_0
	default y if UART_CONSOLE

endif # UART_MCUX_LPUART

if I2C

config I2C_0
	default n

config I2C_1
	default y

endif # I2C

if ADC

config ADC_0
	default y

endif # ADC

endif # BOARD_FRDM_KL27Z
```
